## Kconfig
```kconfig
menuconfig COMPONENTS_100ASK_R128_DEMOS
	bool "USE 100ask_r128_demos"
	default n

if COMPONENTS_100ASK_R128_DEMOS

source components/common/thirdparty/100ask_r128_demos/get_started/Kconfig
source components/common/thirdparty/100ask_r128_demos/module_driver/Kconfig

config LV_100ASK_DESKTOP
	bool "100ask lvgl desktop"
	default n
		help
		lvgl examples use lvgl.
		https://forums.100ask.net

config NWATCH_100ASK
	bool "NWatch demo"
	default n
		help
		https://forums.100ask.net

endif
```

## get_started/Kconfig
```kconfig
menuconfig USE_100ASK_GET_STARTED
	bool "USE USE_100ASK_GET_STARTED"
	default n

if USE_100ASK_GET_STARTED

source components/common/thirdparty/100ask_r128_demos/get_started/src/hello_world/Kconfig
source components/common/thirdparty/100ask_r128_demos/get_started/src/blink/Kconfig

endif
```

## get_started/src/blink/Kconfig
```kconfig
menuconfig USE_100ASK_GET_STARTED_BLINK
	bool "USE USE_100ASK_GET_STARTED_BLINK"
	default n

if USE_100ASK_GET_STARTED_BLINK

endif
```

## get_started/src/hello_world/Kconfig
```kconfig
menuconfig USE_100ASK_GET_STARTED_HELLO_WORLD
	bool "USE USE_100ASK_GET_STARTED_HELLO_WORLD"
	default n

if USE_100ASK_GET_STARTED_HELLO_WORLD

endif
```

## module_driver/Kconfig
```kconfig
menuconfig USE_100ASK_MODULE_DRIVER
	bool "USE USE_100ASK_MODULE_DRIVER"
	default n

if USE_100ASK_MODULE_DRIVER

source components/common/thirdparty/100ask_r128_demos/module_driver/src/iic_oled/Kconfig
source components/common/thirdparty/100ask_r128_demos/module_driver/src/spi_lcd/Kconfig
source components/common/thirdparty/100ask_r128_demos/module_driver/src/passive_buzzer/Kconfig
source components/common/thirdparty/100ask_r128_demos/module_driver/src/rotary_encoder/Kconfig
source components/common/thirdparty/100ask_r128_demos/module_driver/src/ir_receiver/Kconfig
source components/common/thirdparty/100ask_r128_demos/module_driver/src/spi_flash/Kconfig
source components/common/thirdparty/100ask_r128_demos/module_driver/src/dht11/Kconfig
source components/common/thirdparty/100ask_r128_demos/module_driver/src/servo/Kconfig
source components/common/thirdparty/100ask_r128_demos/module_driver/src/ws2812/Kconfig

endif
```

## module_driver/src/dht11/Kconfig
```kconfig
menuconfig USE_100ASK_MODULE_DRIVER_DHT11
	bool "USE USE_100ASK_MODULE_DRIVER_DHT11"
	default n

if USE_100ASK_MODULE_DRIVER_DHT11

endif
```

## module_driver/src/iic_oled/Kconfig
```kconfig
menuconfig USE_100ASK_MODULE_DRIVER_IIC_OLED
	bool "USE USE_100ASK_MODULE_DRIVER_IIC_OLED"
	default n

if USE_100ASK_MODULE_DRIVER_IIC_OLED

	config USE_100ASK_MODULE_DRIVER_IIC_OLED_PORT
		int "Configure the iic port"
		default 1

		help
			0: IIC0, 1: IIC1

	config USE_100ASK_MODULE_DRIVER_IIC_OLED_ADDR
		hex "Configure the iic addr"
		default 0x3c

		help
			0: IIC0, 1: IIC1
			
choice
	bool "Select the model of the display"
	default USE_100ASK_MODULE_DRIVER_IIC_OLED_SSD1306
	help
		Default display controller model
	
	config USE_100ASK_MODULE_DRIVER_IIC_OLED_SSD1306
		bool "ssd1306"
		help
			https://forums.100ask.net
endchoice

	config USE_100ASK_MODULE_DRIVER_IIC_OLED_WIDTH
		int "Screen width"
		default 128 if USE_100ASK_MODULE_DRIVER_IIC_OLED_SSD1306

		help
			Configure the display screen width here.

	config USE_100ASK_MODULE_DRIVER_IIC_OLED_HEIGHT
		int "Screen height"
		default 64 if USE_100ASK_MODULE_DRIVER_IIC_OLED_SSD1306

		help
			Configure the display screen height here.

endif
```

## module_driver/src/ir_receiver/Kconfig
```kconfig
menuconfig USE_100ASK_MODULE_DRIVER_IR_RECEIVER
	bool "USE USE_100ASK_MODULE_DRIVER_IR_RECEIVER"
	default n

if USE_100ASK_MODULE_DRIVER_IR_RECEIVER

	config 100ASK_MODULE_DRIVER_IR_RECEIVER_BUFFER
			int "Infrared Remote receiver buffer"
			default 128

			help
				pwm port

endif
```

## module_driver/src/passive_buzzer/Kconfig
```kconfig
menuconfig USE_100ASK_MODULE_DRIVER_PASSIVE_BUZZER
	bool "USE USE_100ASK_MODULE_DRIVER_PASSIVE_BUZZER"
	default n

if USE_100ASK_MODULE_DRIVER_PASSIVE_BUZZER

	config 100ASK_MODULE_DRIVER_PASSIVE_BUZZER_PORT
		int "Configure the pwm PORT"
		default 6

		help
			pwm port
endif
```

## module_driver/src/rotary_encoder/Kconfig
```kconfig
menuconfig USE_100ASK_MODULE_DRIVER_ROTARY_ENCODER
	bool "USE USE_100ASK_MODULE_DRIVER_ROTARY_ENCODER"
	default n

if USE_100ASK_MODULE_DRIVER_ROTARY_ENCODER

endif
```

## module_driver/src/servo/Kconfig
```kconfig
menuconfig USE_100ASK_MODULE_DRIVER_SERVO
	bool "USE USE_100ASK_MODULE_DRIVER_SERVO"
	default n

if USE_100ASK_MODULE_DRIVER_SERVO

	config 100ASK_MODULE_DRIVER_SERVO_PORT
		int "Configure the pwm PORT"
		default 0

		help
			pwm port
endif
```

## module_driver/src/spi_flash/Kconfig
```kconfig
menuconfig USE_100ASK_MODULE_DRIVER_SPI_FLASH
	bool "USE USE_100ASK_MODULE_DRIVER_SPI_FLASH"
	default n

if USE_100ASK_MODULE_DRIVER_SPI_FLASH

	config 100ASK_MODULE_DRIVER_SPI_FLASH_PORT
		int "Configure the SPI PORT"
		default 1

		help
			0: SPI0, 1: SPI1

	config 100ASK_MODULE_DRIVER_SPI_FLASH_FREQUENCY
		int "Configure the SPI frequency"
		default 18000000

		help
			Configure the SPI frequency here.

choice
	bool "Select the flash type"
	default USE_100ASK_MODULE_DRIVER_SPI_FLASH_W25Q64
	help
		Default flash
	
	config USE_100ASK_MODULE_DRIVER_SPI_FLASH_W25Q64
		bool "W25Q64"
		help
			https://forums.100ask.net
endchoice

endif
```

## module_driver/src/spi_lcd/Kconfig
```kconfig
menuconfig USE_100ASK_MODULE_DRIVER_SPI_LCD
	bool "USE USE_100ASK_MODULE_DRIVER_SPI_LCD"
	default n

if USE_100ASK_MODULE_DRIVER_SPI_LCD

	config 100ASK_MODULE_DRIVER_SPI_LCD_SPI_PORT
		int "Configure the display screen SPI PORT"
		default 1

		help
			0: SPI0, 1: SPI1

	config 100ASK_MODULE_DRIVER_SPI_LCD_FREQUENCY
		int "Configure the display screen SPI frequency"
		default 40000000

		help
			Configure the display SPI frequency here.
	
	config 100ASK_MODULE_DRIVER_SPI_LCD_PWM_PORT
		int "Configure the pwm port(Backlight)"
		default 6

		help
			pwm pprt
		
choice
	bool "Select the model of the display"
	default USE_100ASK_MODULE_DRIVER_SPI_LCD_ST7796S
	help
		Default display controller model
	
	config USE_100ASK_MODULE_DRIVER_SPI_LCD_ST7796S
		bool "st7796s"
		help
			https://forums.100ask.net

	config USE_100ASK_MODULE_DRIVER_SPI_LCD_ILI9341
		bool "ili9341"
		help
			No yet. https://forums.100ask.net

endchoice

 	config 100ASK_MODULE_DRIVER_SPI_LCD_ROTATION
		int "Set display rotation angle"
		default 0

		help
			The rotation angles you can choose are: 90, 180, 270.

	config 100ASK_MODULE_DRIVER_SPI_LCD_WIDTH
		int "Screen width"
		default 320 if USE_100ASK_MODULE_DRIVER_SPI_LCD_ST7796S

		help
			Configure the display screen width here.

	config 100ASK_MODULE_DRIVER_SPI_LCD_HEIGHT
		int "Screen height"
		default 480 if USE_100ASK_MODULE_DRIVER_SPI_LCD_ST7796S

		help
			Configure the display screen height here.
	
endif
```

## module_driver/src/ws2812/Kconfig
```kconfig
menuconfig USE_100ASK_MODULE_DRIVER_WS2812
	bool "USE USE_100ASK_MODULE_DRIVER_WS2812"
	default n

if USE_100ASK_MODULE_DRIVER_WS2812

endif
```

## other/spi_lcd/spilcd/lcd_fb/panels/Kconfig
```kconfig
config LCD_SUPPORT_KLD2844B
	bool "LCD support kld2844B panel"
	default n
	---help---
		If you want to support kld2844b panel for display driver, select it.

config LCD_SUPPORT_KLD35512
	bool "LCD support kld35512 panel"
    default n
    ---help---
		If you want to support kld35512 panel for display driver, select it.

config LCD_SUPPORT_KLD39501
	bool "LCD support kld39501 panel"
	default n
	---help---
		If you want to support kld39501 panel for display driver, select it.

config LCD_SUPPORT_NV3029S
	bool "LCD support nv3029s panel"
	default n
	---help---
		If you want to support nv3029s panel for display driver, select it.

config LCD_SUPPORT_JLT35031C
	bool "LCD support JLT35031C panel"
	default n
	---help---
		If you want to support JLT35031C panel for display driver, select it.


menu "100ASK LCD configure"
	depends on LCD_100ASK_SUPPORT

	config LCD_SUPPORT_100ASK
		bool "LCD support 100ask panel"
		default y
		---help---
			If you want to support 100ask panel for display driver, select it.

	choice
		bool "Select the model of the display"
		default USE_100ASK_DISPLAY_SCREEN_320X480
		help
			Default display controller model
		
		config USE_100ASK_DISPLAY_SCREEN_240X240
			bool "240X240"
			help
				https://forums.100ask.net

		config USE_100ASK_DISPLAY_SCREEN_320X480
			bool "320X480"
			help
				https://forums.100ask.net
	endchoice

	config DISPLAY_SCREEN_100ASK_ROTATION
		int "Set display rotation angle (90, 180, 270)"
		default 0

		help
			The rotation angles you can choose are: 90, 180, 270.
endmenu
```

## other/spi_lcd/spilcd/soc/Kconfig
```kconfig
config KLD2844B_SUPPORT
	bool "board kld2844b support"
	default n
	---help---
	  board kld2844b support

config KLD35512_SUPPORT
	bool "board kld35512 support"
	default n
	---help---
	  board kld35512 support

config LCD_100ASK_SUPPORT
	bool "board lcd 100ask support"
	default n
	---help---
	  board lcd 100ask support
```
